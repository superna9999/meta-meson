## conf/machine/khadas-vim3l-sdboot.conf
```bitbake
#@TYPE: Machine
#@NAME: Khadas VIM3L machine
#@DESCRIPTION: Machine configuration for legacy boot

require conf/machine/include/amlogic-s905d3.inc
require conf/machine/include/khadas-vim3l-dtb.inc

EXTRA_IMAGEDEPENDS += "s905-autoscript s905-autoscript-multiboot"
IMAGE_BOOT_FILES += " s905_autoscript aml_autoscript aml_autoscript.zip"
```

## conf/machine/khadas-vim3l.conf
```bitbake
#@TYPE: Machine
#@NAME: Khadas VIM3L machine
#@DESCRIPTION: Machine configuration

require conf/machine/include/amlogic-s905d3.inc
require conf/machine/include/khadas-vim3l-dtb.inc
require conf/machine/include/amlogic-modern-boot.inc

MACHINE_FEATURES:append = " alsa ext2 screen usbgadget usbhost sdio vfat wifi bluetooth"

PREFERRED_PROVIDER_amlogic-fip = "amlogic-fip-prebuilt"

UBOOT_MACHINE = "khadas-vim3l_defconfig"
```

## conf/machine/kingnovel-rbox-pro.conf
```bitbake
#@TYPE: Machine
#@NAME: Kingnovel RBox Pro machine
#@DESCRIPTION: Machine configuration for legacy boot

require conf/machine/include/amlogic-s912.inc
require conf/machine/include/kingnovel-rbox-pro-dtb.inc
require conf/machine/include/amlogic-legacy-boot.inc

MACHINE_FEATURES_append = " alsa ext2 screen usbgadget usbhost sdio vfat wifi bluetooth"
```

## conf/machine/libretech-ac.conf
```bitbake
#@TYPE: Machine
#@NAME: LibreTech AC (AML-S805X-AC La Frite) machine
#@DESCRIPTION: Machine configuration for USB bootable image

require conf/machine/include/amlogic-s905x.inc
require conf/machine/include/libretech-ac-dtb.inc
require conf/machine/include/amlogic-modern-boot.inc

MACHINE_FEATURES_append = " alsa ext2 screen usbgadget usbhost sdio vfat"


UBOOT_MACHINE = "libretech-ac_defconfig"
UBOOT_EXTLINUX_ROOT ?= "root=/dev/sda1"
```

## conf/machine/libretech-cc-sdboot.conf
```bitbake
#@TYPE: Machine
#@NAME: LibreTech CC machine
#@DESCRIPTION: Machine configuration for legacy boot

require conf/machine/include/amlogic-s905x.inc
require conf/machine/include/libretech-cc-dtb.inc
require conf/machine/include/amlogic-legacy-boot.inc
```

## conf/machine/libretech-cc.conf
```bitbake
#@TYPE: Machine
#@NAME: LibreTech CC (aka Le Potato) machine
#@DESCRIPTION: Machine configuration

require conf/machine/include/amlogic-s905x.inc
require conf/machine/include/libretech-cc-dtb.inc
require conf/machine/include/amlogic-modern-boot.inc

MACHINE_FEATURES:append = " alsa ext2 screen usbgadget usbhost sdio vfat"


UBOOT_MACHINE = "libretech-cc_defconfig"
```

## conf/machine/mecool-kii-pro.conf
```bitbake
#@TYPE: Machine
#@NAME: MeCool KII Pro
#@DESCRIPTION: Machine configuration for legacy boot

require conf/machine/include/amlogic-s905x.inc
require conf/machine/include/mecool-kii-pro-dtb.inc
require conf/machine/include/amlogic-legacy-boot.inc

MACHINE_FEATURES:append = " alsa ext2 screen usbgadget usbhost sdio vfat wifi bluetooth"
```

## conf/machine/mecool-kiii-pro.conf
```bitbake
#@TYPE: Machine
#@NAME: MeCool KIII Pro
#@DESCRIPTION: Machine configuration for legacy boot

require conf/machine/include/amlogic-s912.inc
require conf/machine/include/mecool-kiii-pro-dtb.inc
require conf/machine/include/amlogic-legacy-boot.inc

MACHINE_FEATURES:append = " alsa ext2 screen usbgadget usbhost sdio vfat wifi bluetooth"
```

## conf/machine/minix-neo-u9h.conf
```bitbake
#@TYPE: Machine
#@NAME: Minix NEO U9-H
#@DESCRIPTION: Machine configuration for legacy boot

require conf/machine/include/amlogic-s912.inc
require conf/machine/include/minix-neo-u9h-dtb.inc
require conf/machine/include/amlogic-legacy-boot.inc

MACHINE_FEATURES:append = " alsa ext2 screen usbgadget usbhost sdio vfat wifi bluetooth"
```

## conf/machine/nexbox-a1.conf
```bitbake
#@TYPE: Machine
#@NAME: Nexbox A1 machine
#@DESCRIPTION: Machine configuration for legacy boot

require conf/machine/include/amlogic-s912.inc
require conf/machine/include/nexbox-a1-dtb.inc
require conf/machine/include/amlogic-legacy-boot.inc
```

## conf/machine/nexbox-a95x-s905.conf
```bitbake
#@TYPE: Machine
#@NAME: Nexbox A95 machine
#@DESCRIPTION: Machine configuration for legacy boot

require conf/machine/include/amlogic-s905.inc
require conf/machine/include/nexbox-a95x-s905-dtb.inc

EXTRA_IMAGEDEPENDS += "s905-autoscript s905-autoscript-multiboot"
IMAGE_BOOT_FILES += " s905_autoscript aml_autoscript aml_autoscript.zip"
```

## conf/machine/nexbox-a95x-s905x.conf
```bitbake
#@TYPE: Machine
#@NAME: Nexbox A95X (s905x) machine
#@DESCRIPTION: Machine configuration for legacy boot

require conf/machine/include/amlogic-s905x.inc
require conf/machine/include/nexbox-a95x-s905x-dtb.inc
require conf/machine/include/amlogic-legacy-boot.inc
```

## conf/machine/oranth-tx3-mini-sdboot.conf
```bitbake
#@TYPE: Machine
#@NAME: Oranth Tanix TX3 Mini and Max machine
#@DESCRIPTION: Machine configuration for legacy boot

require conf/machine/include/amlogic-s905x.inc
require conf/machine/include/oranth-tx3-mini-dtb.inc
require conf/machine/include/amlogic-legacy-boot.inc

MACHINE_FEATURES_append = " alsa ext2 screen usbgadget usbhost sdio vfat wifi bluetooth"

KERNEL_IMAGETYPE = "uImage"
KERNEL_CLASSES = "kernel-uimage-meson"
```

## conf/machine/oranth-tx3-mini.conf
```bitbake
#@TYPE: Machine
#@NAME: Oranth Tanix TX3 Mini machine
#@DESCRIPTION: Machine configuration for legacy boot

require conf/machine/include/amlogic-s905x.inc
require conf/machine/include/oranth-tx3-mini-dtb.inc
require conf/machine/include/amlogic-legacy-boot.inc

MACHINE_FEATURES_append = " alsa ext2 screen usbgadget usbhost sdio vfat wifi bluetooth"
```

## conf/machine/osmc-vero4k-plus.conf
```bitbake
#@TYPE: Machine
#@NAME: OSMC Vero 4K+
#@DESCRIPTION: Machine configuration for legacy boot

require conf/machine/include/amlogic-s905d.inc
require conf/machine/include/osmc-vero4k-plus-dtb.inc
require conf/machine/include/amlogic-legacy-boot.inc

MACHINE_FEATURES:append = " alsa ext2 screen usbgadget usbhost sdio vfat wifi bluetooth"
```

## conf/machine/radxa-zero.conf
```bitbake
#@TYPE: Machine
#@NAME: Radxa-Zero machine
#@DESCRIPTION: Machine configuration

require conf/machine/include/amlogic-s905y2.inc
require conf/machine/include/radxa-zero-dtb.inc
require conf/machine/include/amlogic-modern-boot.inc

MACHINE_FEATURES:append = " alsa ext2 screen usbgadget usbhost vfat"

UBOOT_MACHINE = "radxa-zero_config"

# If this is populated in amlogic-meson.inc, it doesn't need
# to be here as well.  This is just another method of specifying the correct
# firmware for a given machine.  This seems to align more similarly with other repos vs.
# doing this in amlogic-meson.inc
MACHINE_ESSENTIAL_EXTRA_RDEPENDS += " \
       linux-firmware-bcm43455 \
       linux-firmware-bcm43456 \
       linux-firmware-bcm4345c0-hcd \
       linux-firmware-bcm4345c5-hcd \
"
```

## conf/machine/seirobotics-sei510.conf
```bitbake
#@TYPE: Machine
#@NAME: SEI Robotics SEI510 machine
#@DESCRIPTION: Machine configuration

require conf/machine/include/amlogic-s905x2.inc
require conf/machine/include/seirobotics-sei510-dtb.inc
require conf/machine/include/amlogic-modern-boot.inc

PREFERRED_PROVIDER_amlogic-fip = "amlogic-fip-prebuilt"

UBOOT_MACHINE = "sei510_defconfig"
UBOOT_EXTLINUX_ROOT ?= "root=/dev/mmcblk0p1"
UBOOT_EXTLINUX_FDT = "../meson-g12a-sei510.dtb"

MACHINE_ESSENTIAL_EXTRA_RDEPENDS += " \
       alsa-state \
"
```

## conf/machine/seirobotics-sei610.conf
```bitbake
#@TYPE: Machine
#@NAME: SEI Robotics SEI610 machine
#@DESCRIPTION: Machine configuration

require conf/machine/include/amlogic-s905x3.inc
require conf/machine/include/seirobotics-sei610-dtb.inc
require conf/machine/include/amlogic-modern-boot.inc

MACHINE_FEATURES_append = " alsa ext2 screen usbgadget usbhost sdio vfat wifi bluetooth"

PREFERRED_PROVIDER_amlogic-fip = "amlogic-fip-prebuilt"

UBOOT_MACHINE = "sei610_defconfig"
UBOOT_EXTLINUX_ROOT ?= "root=/dev/mmcblk0p1"
UBOOT_EXTLINUX_FDT = "../meson-sm1-sei610.dtb"

MACHINE_ESSENTIAL_EXTRA_RDEPENDS += " \
       alsa-state \
"
```

## conf/machine/tronsmart-vega-s95-meta.conf
```bitbake
#@TYPE: Machine
#@NAME: Tronsmart Vega S95 Meta machine
#@DESCRIPTION: Machine configuration for legacy boot

require conf/machine/include/amlogic-s905.inc
require conf/machine/include/tronsmart-vega-s95-meta-dtb.inc
require conf/machine/include/amlogic-legacy-boot.inc
```

## conf/machine/tronsmart-vega-s95-pro.conf
```bitbake
#@TYPE: Machine
#@NAME: Tronsmart Vega S95 Pro machine
#@DESCRIPTION: Machine configuration for legacy boot

require conf/machine/include/amlogic-s905.inc
require conf/machine/include/tronsmart-vega-s95-pro-dtb.inc
require conf/machine/include/amlogic-legacy-boot.inc

MACHINE_FEATURES_append = " alsa ext2 screen usbgadget usbhost sdio vfat wifi bluetooth"
```

## conf/machine/tronsmart-vega-s95-telos.conf
```bitbake
#@TYPE: Machine
#@NAME: Tronsmart Vega S95 Telos machine
#@DESCRIPTION: Machine configuration for legacy boot

require conf/machine/include/amlogic-s905.inc
require conf/machine/include/tronsmart-vega-s95-telos-dtb.inc
require conf/machine/include/amlogic-legacy-boot.inc
```

## conf/machine/tronsmart-vega-s96.conf
```bitbake
#@TYPE: Machine
#@NAME: Tronsmart Vega S96 machine
#@DESCRIPTION: Machine configuration for legacy boot

require conf/machine/include/amlogic-s912.inc
require conf/machine/include/tronsmart-vega-s96-dtb.inc
require conf/machine/include/amlogic-legacy-boot.inc
```

## conf/machine/vega-s96.conf
```bitbake
# Nexbox A1 board

require conf/machine/include/amlogic-s912.inc
require conf/machine/include/vega-s96-dtb.inc
```

## conf/machine/wetek-hub.conf
```bitbake
#@TYPE: Machine
#@NAME: Wetek Hub machine
#@DESCRIPTION: Machine configuration for legacy boot

require conf/machine/include/amlogic-s905.inc
require conf/machine/include/wetek-hub-dtb.inc
require conf/machine/include/amlogic-legacy-boot.inc

MACHINE_FEATURES_append = " alsa ext2 screen usbgadget usbhost sdio vfat wifi bluetooth"
```

## conf/machine/wetek-play2.conf
```bitbake
#@TYPE: Machine
#@NAME: Wetek Play2 machine
#@DESCRIPTION: Machine configuration for legacy boot

require conf/machine/include/amlogic-s905.inc
require conf/machine/include/wetek-play2-dtb.inc

EXTRA_IMAGEDEPENDS += "s905-autoscript s905-autoscript-multiboot"
IMAGE_BOOT_FILES += " s905_autoscript aml_autoscript aml_autoscript.zip"
```
