## conf/machine/include/amlogic-s912.inc
```bitbake
# Amlogic S912 Configurations

require conf/machine/include/amlogic-meson64.inc

MACHINE_FEATURES = "serial usbhost sdio screen wifi"

SOC_FAMILY_append = ":meson-gxm"
```

## conf/machine/include/amlogic-s922x.inc
```bitbake
# Amlogic S922X Configurations

require conf/machine/include/amlogic-meson64.inc

SOC_FAMILY_append = ":meson-g12b"
```

## conf/machine/include/amlogic-s9xxx.inc
```bitbake
# Amlogic S9xxx Configurations

require conf/machine/include/amlogic-meson64.inc

require conf/machine/include/arm/arch-armv8a.inc

EXTRA_IMAGEDEPENDS += " s905-autoscript s905-autoscript-multiboot"
IMAGE_BOOT_FILES += " s905_autoscript aml_autoscript aml_autoscript.zip"
```

## conf/machine/include/amlogic-u200-dtb.inc
```bitbake
# Amlogic U200

KERNEL_DEVICETREE += "amlogic/meson-g12a-u200.dtb"
IMAGE_BOOT_FILES += "meson-g12a-u200.dtb:meson-g12a-u200.dtb"
```

## conf/machine/include/bananapi-bpi-cm4io-dtb.inc
```bitbake
# Banana Pi CM4IO dtb

KERNEL_DEVICETREE += "amlogic/meson-g12b-bananapi-cm4-cm4io.dtb"
IMAGE_BOOT_FILES += "meson-g12b-bananapi-cm4-cm4io.dtb"
```

## conf/machine/include/bananapi-bpi-m2-pro-dtb.inc
```bitbake
# Banana Pi M2 Pro dtb

KERNEL_DEVICETREE += "amlogic/meson-sm1-bananapi-m2-pro.dtb"
IMAGE_BOOT_FILES += "meson-sm1-bananapi-m2-pro.dtb"
```

## conf/machine/include/bananapi-bpi-m2s-dtb.inc
```bitbake
# Banana Pi M2S dtb

KERNEL_DEVICETREE += "amlogic/meson-g12b-a311d-bananapi-m2s.dtb"
IMAGE_BOOT_FILES += "meson-g12b-a311d-bananapi-m2s.dtb"
```

## conf/machine/include/bananapi-bpi-m5-dtb.inc
```bitbake
# Banana Pi M5 dtb

KERNEL_DEVICETREE += "amlogic/meson-sm1-bananapi-m5.dtb"
IMAGE_BOOT_FILES += "meson-sm1-bananapi-m5.dtb"
```

## conf/machine/include/beelink-gt1-ultimate-dtb.inc
```bitbake
# Beelink GT1 Ultimate dtb

KERNEL_DEVICETREE += "amlogic/meson-gxm-gt1-ultimate.dtb"
IMAGE_BOOT_FILES += "meson-gxm-gt1-ultimate.dtb"
```

## conf/machine/include/cyx-a95xf3-air-dtb.inc
```bitbake
# CYX A95XF3-AIR

KERNEL_DEVICETREE += "amlogic/meson-sm1-a95xf3-air.dtb"
IMAGE_BOOT_FILES += "meson-sm1-a95xf3-air.dtb"
```

## conf/machine/include/cyx-a95xf3-air-gbit-dtb.inc
```bitbake
# CYX A95XF3-AIR Gigabit edition

KERNEL_DEVICETREE += "amlogic/meson-sm1-a95xf3-air-gbit.dtb"
IMAGE_BOOT_FILES += "meson-sm1-a95xf3-air-gbit.dtb"
```

## conf/machine/include/friendlyelec-nanopik2-dtb.inc
```bitbake
# FriendlyElec's NanoPi K2 dtb

KERNEL_DEVICETREE += "amlogic/meson-gxbb-nanopi-k2.dtb"
IMAGE_BOOT_FILES += "meson-gxbb-nanopi-k2.dtb;meson-gxbb-nanopi-k2.dtb"
```

## conf/machine/include/haochuangy-h96-max-dtb.inc
```bitbake
# Haochuangy H96-Max

KERNEL_DEVICETREE += "amlogic/meson-sm1-h96-max.dtb"
IMAGE_BOOT_FILES += "meson-sm1-h96-max.dtb"
```

## conf/machine/include/hardkernel-odroid-go-ultra-dtb.inc
```bitbake
# Hardkernel Odroid Go Ultra dtb

KERNEL_DEVICETREE += "amlogic/meson-g12b-odroid-go-ultra.dtb"
IMAGE_BOOT_FILES += "meson-g12b-odroid-go-ultra.dtb"
```

## conf/machine/include/hardkernel-odroid-n2l-dtb.inc
```bitbake
# Hardkernel Odroid-N2l dtb

KERNEL_DEVICETREE += "amlogic/meson-g12b-odroid-n2l.dtb"
IMAGE_BOOT_FILES += "meson-g12b-odroid-n2l.dtb"
```

## conf/machine/include/hardkernel-odroidc1-dtb.inc
```bitbake
# Hardkernel Odroid-C1 dtb

KERNEL_DEVICETREE += "meson8b-odroidc1.dtb"
IMAGE_BOOT_FILES += "meson8b-odroidc1.dtb;meson8b-odroidc1.dtb"
```

## conf/machine/include/hardkernel-odroidc2-dtb.inc
```bitbake
# Hardkernel Odroid-C2 dtb

KERNEL_DEVICETREE += "amlogic/meson-gxbb-odroidc2.dtb"
IMAGE_BOOT_FILES += "meson-gxbb-odroidc2.dtb;meson-gxbb-odroidc2.dtb"
```

## conf/machine/include/hardkernel-odroidhc4-dtb.inc
```bitbake
# Hardkernel Odroid-C4 dtb

KERNEL_DEVICETREE += "amlogic/meson-sm1-odroid-c4.dtb"
IMAGE_BOOT_FILES += "meson-sm1-odroid-c4.dtb"
```

## conf/machine/include/hardkernel-odroidn2-dtb.inc
```bitbake
# Hardkernel Odroid-N2 dtb

KERNEL_DEVICETREE += "amlogic/meson-g12b-odroid-n2.dtb"
IMAGE_BOOT_FILES += "meson-g12b-odroid-n2.dtb;meson-g12b-odroid-n2.dtb"
```

## conf/machine/include/hwacom-amazetv-dtb.inc
```bitbake
# hwacom amazetv

KERNEL_DEVICETREE += "amlogic/meson-gxl-s905x-hwacom-amazetv.dtb"
IMAGE_BOOT_FILES += "meson-gxl-s905x-hwacom-amazetv.dtb;meson-gxl-s905x-hwacom-amazetv.dtb"
```

## conf/machine/include/khadas-vim-dtb.inc
```bitbake
# Khadas VIM

KERNEL_DEVICETREE += "amlogic/meson-gxl-s905x-khadas-vim.dtb"
IMAGE_BOOT_FILES += "meson-gxl-s905x-khadas-vim.dtb;meson-gxl-s905x-khadas-vim.dtb"
```

## conf/machine/include/khadas-vim2-dtb.inc
```bitbake
# Khadas VIM2

KERNEL_DEVICETREE += "amlogic/meson-gxm-khadas-vim2.dtb"
IMAGE_BOOT_FILES += "Image-meson-gxm-khadas-vim2.dtb;meson-gxm-khadas-vim2.dtb"
```

## conf/machine/include/khadas-vim3-dtb.inc
```bitbake
# Khadas VIM3 (supports both A311D and S922X version)

KERNEL_DEVICETREE += "amlogic/meson-g12b-a311d-khadas-vim3.dtb"
KERNEL_DEVICETREE += "amlogic/meson-g12b-s922x-khadas-vim3.dtb"
IMAGE_BOOT_FILES += "meson-g12b-a311d-khadas-vim3.dtb:meson-g12b-s922x-khadas-vim3.dtb"
```

## conf/machine/include/khadas-vim3-s922x-dtb.inc
```bitbake
# Khadas VIM3 with S922X

KERNEL_DEVICETREE += "amlogic/meson-g12b-s922x-khadas-vim3.dtb"
IMAGE_BOOT_FILES += "meson-g12b-s922x-khadas-vim3.dtb:meson-g12b-s922x-khadas-vim3.dtb"
```

## conf/machine/include/khadas-vim3l-dtb.inc
```bitbake
# Khadas VIM3L

KERNEL_DEVICETREE += "amlogic/meson-sm1-khadas-vim3l.dtb"
IMAGE_BOOT_FILES += "meson-sm1-khadas-vim3l.dtb"
```
