## conf/machine/include/kingnovel-rbox-pro-dtb.inc
```bitbake
# KingNovel Rbox Pro

KERNEL_DEVICETREE += "amlogic/meson-gxm-rbox-pro.dtb"
IMAGE_BOOT_FILES += "meson-gxm-rbox-pro.dtb;meson-gxm-rbox-pro.dtb"
```

## conf/machine/include/libretech-ac-dtb.inc
```bitbake
# LibreTech AC AML-S805X-AC (La Frite)

KERNEL_DEVICETREE += "amlogic/meson-gxl-s805x-libretech-ac.dtb"
IMAGE_BOOT_FILES += "meson-gxl-s805x-libretech-ac.dtb;meson-gxl-s805x-libretech-ac.dtb"
```

## conf/machine/include/libretech-cc-dtb.inc
```bitbake
# LibreTech CC

KERNEL_DEVICETREE += "amlogic/meson-gxl-s905x-libretech-cc.dtb"
IMAGE_BOOT_FILES += "meson-gxl-s905x-libretech-cc.dtb;meson-gxl-s905x-libretech-cc.dtb"
```

## conf/machine/include/mecool-kii-pro-dtb.inc
```bitbake
# MeCool KII Pro dtb

KERNEL_DEVICETREE += "amlogic/meson-gxl-s905d-mecool-kii-pro.dtb"
IMAGE_BOOT_FILES += "meson-gxl-s905d-mecool-kii-pro.dtb"
```

## conf/machine/include/mecool-kiii-pro-dtb.inc
```bitbake
# MeCool KIII Pro dtb

KERNEL_DEVICETREE += "amlogic/meson-gxm-mecool-kiii-pro.dtb"
IMAGE_BOOT_FILES += "meson-gxm-mecool-kiii-pro.dtb"
```

## conf/machine/include/minix-neo-u9h-dtb.inc
```bitbake
# Minix NEO U9-H dtb

KERNEL_DEVICETREE += "amlogic/meson-gxm-minix-neo-u9h.dtb"
IMAGE_BOOT_FILES += "meson-gxm-minix-neo-u9h.dtb"
```

## conf/machine/include/nexbox-a1-dtb.inc
```bitbake
# Nexbox A1

KERNEL_DEVICETREE += "amlogic/meson-gxm-nexbox-a1.dtb"
IMAGE_BOOT_FILES += "meson-gxm-nexbox-a1.dtb;meson-gxm-nexbox-a1.dtb"
```

## conf/machine/include/nexbox-a95x-s905-dtb.inc
```bitbake
# Nexbox A95X

KERNEL_DEVICETREE += "amlogic/meson-gxbb-nexbox-a95x.dtb"
IMAGE_BOOT_FILES += "meson-gxbb-nexbox-a95x.dtb;meson-gxbb-nexbox-a95x.dtb"
```

## conf/machine/include/nexbox-a95x-s905x-dtb.inc
```bitbake
# Nexbox A95X (S905X)

KERNEL_DEVICETREE += "amlogic/meson-gxl-s905x-nexbox-a95x.dtb"
IMAGE_BOOT_FILES += "meson-gxl-s905x-nexbox-a95x.dtb;meson-gxl-s905x-nexbox-a95x.dtb"
```

## conf/machine/include/oranth-tx3-mini-dtb.inc
```bitbake
# Oranth Tanix TX3 Mini

KERNEL_DEVICETREE += "amlogic/meson-gxl-s905w-tx3-mini.dtb"
IMAGE_BOOT_FILES += "meson-gxl-s905w-tx3-mini.dtb;meson-gxl-s905w-tx3-mini.dtb"
```

## conf/machine/include/osmc-vero4k-plus-dtb.inc
```bitbake
# OSMC Vero 4K+

KERNEL_DEVICETREE += "amlogic/meson-gxl-s905d-vero4k-plus.dtb"
IMAGE_BOOT_FILES += "meson-gxl-s905d-vero4k-plus.dtb"
```

## conf/machine/include/radxa-zero-dtb.inc
```bitbake
# Radxa Zero dtb

KERNEL_DEVICETREE += "amlogic/meson-g12a-radxa-zero.dtb"
IMAGE_BOOT_FILES += "meson-g12a-radxa-zero.dtb"
```

## conf/machine/include/seirobotics-sei510-dtb.inc
```bitbake
# Seirobotics SEI510

KERNEL_DEVICETREE += "amlogic/meson-g12a-sei510.dtb"
IMAGE_BOOT_FILES += "meson-g12a-sei510.dtb:meson-g12a-sei510.dtb"
```

## conf/machine/include/seirobotics-sei610-dtb.inc
```bitbake
# SEI Robotics SEI610

KERNEL_DEVICETREE += "amlogic/meson-sm1-sei610.dtb"
IMAGE_BOOT_FILES += "meson-sm1-sei610.dtb"
```

## conf/machine/include/tronsmart-vega-s95-meta-dtb.inc
```bitbake
# tronsmart-vega-s95-meta dtb

KERNEL_DEVICETREE += "amlogic/meson-gxbb-vega-s95-meta.dtb"
IMAGE_BOOT_FILES += "meson-gxbb-vega-s95-meta.dtb;meson-gxbb-vega-s95-meta.dtb"
```

## conf/machine/include/tronsmart-vega-s95-pro-dtb.inc
```bitbake
# tronsmart-vega-s95-pro dtb

KERNEL_DEVICETREE += "amlogic/meson-gxbb-vega-s95-pro.dtb"
IMAGE_BOOT_FILES += "meson-gxbb-vega-s95-pro.dtb;meson-gxbb-vega-s95-pro.dtb"
```

## conf/machine/include/tronsmart-vega-s95-telos-dtb.inc
```bitbake
# tronsmart-vega-s95-telos dtb

KERNEL_DEVICETREE += "amlogic/meson-gxbb-vega-s95-telos.dtb"
IMAGE_BOOT_FILES += "meson-gxbb-vega-s95-telos.dtb;meson-gxbb-vega-s95-telos.dtb"
```

## conf/machine/include/tronsmart-vega-s96-dtb.inc
```bitbake
# Tronsmart Vega S96

KERNEL_DEVICETREE += "amlogic/meson-gxm-vega-s96.dtb"
IMAGE_BOOT_FILES += "Image-meson-gxm-vega-s96.dtb;meson-gxm-vega-s96.dtb"
```

## conf/machine/include/wetek-hub-dtb.inc
```bitbake
# Wetek Hub dtb

KERNEL_DEVICETREE += "amlogic/meson-gxbb-wetek-hub.dtb"
IMAGE_BOOT_FILES += "meson-gxbb-wetek-hub.dtb;meson-gxbb-wetek-hub.dtb"
```

## conf/machine/include/wetek-play2-dtb.inc
```bitbake
# Wetek Play2 dtb

KERNEL_DEVICETREE += "amlogic/meson-gxbb-wetek-play2.dtb"
IMAGE_BOOT_FILES += "meson-gxbb-wetek-play2.dtb;meson-gxbb-wetek-play2.dtb"
```

## conf/machine/khadas-vim-sdboot.conf
```bitbake
#@TYPE: Machine
#@NAME: Khadas VIM machine
#@DESCRIPTION: Machine configuration for legacy boot

require conf/machine/include/amlogic-s905x.inc
require conf/machine/include/khadas-vim-dtb.inc
require conf/machine/include/amlogic-legacy-boot.inc
```

## conf/machine/khadas-vim.conf
```bitbake
#@TYPE: Machine
#@NAME: Khadas VIM machine
#@DESCRIPTION: Machine configuration

require conf/machine/include/amlogic-s905x.inc
require conf/machine/include/khadas-vim-dtb.inc
require conf/machine/include/amlogic-modern-boot.inc

MACHINE_FEATURES:append = " alsa ext2 screen usbgadget usbhost sdio vfat wifi bluetooth"

PREFERRED_PROVIDER_amlogic-fip = "amlogic-fip-prebuilt"

UBOOT_MACHINE = "khadas-vim_defconfig"
```

## conf/machine/khadas-vim2.conf
```bitbake
#@TYPE: Machine
#@NAME: Khadas VIM2 machine
#@DESCRIPTION: Machine configuration

require conf/machine/include/amlogic-s912.inc
require conf/machine/include/khadas-vim2-dtb.inc
require conf/machine/include/amlogic-modern-boot.inc

MACHINE_FEATURES_append = " alsa ext2 screen usbgadget usbhost sdio vfat wifi bluetooth"

PREFERRED_PROVIDER_amlogic-fip = "amlogic-fip-prebuilt"

UBOOT_MACHINE = "khadas-vim2_defconfig"
UBOOT_EXTLINUX_ROOT ?= "root=/dev/mmcblk0p1"
UBOOT_EXTLINUX_FDT = "../meson-gxm-khadas-vim2.dtb"
```

## conf/machine/khadas-vim3-sdboot.conf
```bitbake
#@TYPE: Machine
#@NAME: Khadas VIM3 machine
#@DESCRIPTION: Machine configuration for legacy boot

require conf/machine/include/amlogic-a311d.inc
require conf/machine/include/khadas-vim3-dtb.inc
require conf/machine/include/amlogic-legacy-boot.inc
```

## conf/machine/khadas-vim3.conf
```bitbake
#@TYPE: Machine
#@NAME: Khadas VIM3 machine
#@DESCRIPTION: Machine configuration

require conf/machine/include/amlogic-a311d.inc
require conf/machine/include/khadas-vim3-dtb.inc
require conf/machine/include/amlogic-modern-boot.inc

MACHINE_FEATURES_append = " alsa ext2 screen usbgadget usbhost sdio vfat wifi bluetooth"
#
# Kernel
# - Use standard linux-yocto recipe
#
PREFERRED_PROVIDER_virtual/kernel ?= "linux-yocto-dev"
KMACHINE_meson-gx = "meson-gx"

UBOOT_MACHINE = "khadas-vim3_defconfig"
```
