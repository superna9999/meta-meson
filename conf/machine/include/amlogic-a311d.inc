## conf/machine/include/amlogic-a311d.inc
```bitbake
# Amlogic A311D Configurations

require conf/machine/include/amlogic-meson64.inc

require conf/machine/include/arm/arch-armv8a.inc

SOC_FAMILY:append = ":meson-g12b"
```

## conf/machine/include/amlogic-legacy-boot.inc
```bitbake
KERNEL_IMAGETYPE ?= "uImage"

IMAGE_BOOT_FILES ?= "${KERNEL_IMAGETYPE} \
		     s905_autoscript aml_autoscript aml_autoscript.zip"

WKS_FILE ?= "sdimage-bootpart-meson.wks"

EXTRA_IMAGEDEPENDS += "s905-autoscript s905-autoscript-multiboot"
```

## conf/machine/include/amlogic-meson.inc
```bitbake
# Amlogic Meson SoCs configurations

MACHINE_EXTRA_RRECOMMENDS ?= " kernel-modules"

MACHINE_FEATURES ?= "serial"

SERIAL_CONSOLE ?= "115200 ttyAML0"

UBOOT_LOADADDRESS ?= "0x1080000"
UBOOT_ENTRYPOINT ?= "0x01080000"

XSERVER ?= "\
	   xserver-xorg \
           xf86-video-modesetting \
"

# TODO - the changes in linux-firmware_%.bbappend to new override syntax causes build failures when
# installing either linux-firmware-bcm43430 or linux-firware-bcm43430a0:
# - nothing provides linux-firmware-bcm43430a0 needed by packagegroup-core-boot-1.0-r17.radxa_zero
#
# Bascally including either of these in MACHINE_ESSENTIAL_EXTRA_RDEPENDS causes the above error
# MACHINE_ESSENTIAL_EXTRA_RDEPENDS += " \
#        ${@bb.utils.contains("MACHINE_FEATURES", "wifi", "linux-firmware-bcm43430", "",d)} \
#        ${@bb.utils.contains("MACHINE_FEATURES", "wifi", "linux-firmware-bcm43430a0", "",d)} \
# "
# For now I'm taking an aggressive approach and not installing anything other than what I need, selfishly.
#
# TODO - figure out where these belong, probably in the machine conf _or_ using the :<machine> override syntax
# as surely not all amlogic based systems need _all_ firmwares installed
# MACHINE_ESSENTIAL_EXTRA_RDEPENDS += " \
#        ${@bb.utils.contains("MACHINE_FEATURES", "wifi", "linux-firmware-bcm4329", "",d)} \
#        ${@bb.utils.contains("MACHINE_FEATURES", "wifi", "linux-firmware-bcm4330", "",d)} \
#        ${@bb.utils.contains("MACHINE_FEATURES", "wifi", "linux-firmware-bcm4335", "",d)} \
#        ${@bb.utils.contains("MACHINE_FEATURES", "wifi", "linux-firmware-bcm43362", "",d)} \
#        ${@bb.utils.contains("MACHINE_FEATURES", "wifi", "linux-firmware-bcm43430", "",d)} \
#        ${@bb.utils.contains("MACHINE_FEATURES", "wifi", "linux-firmware-bcm43430a0", "",d)} \
#        ${@bb.utils.contains("MACHINE_FEATURES", "wifi", "linux-firmware-bcm43455", "",d)} \
#        ${@bb.utils.contains("MACHINE_FEATURES", "wifi", "linux-firmware-bcm4354", "",d)} \
#        ${@bb.utils.contains("MACHINE_FEATURES", "wifi", "linux-firmware-bcm4356", "",d)} \
#        ${@bb.utils.contains("MACHINE_FEATURES", "screen", "linux-firmware-amlogic-vdec", "",d)} \
# "

# An example using :<machine> override
# MACHINE_ESSENTIAL_EXTRA_RDEPENDS:radxa-zero += " \
#         ${@bb.utils.contains("MACHINE_FEATURES", "wifi", "linux-firmware-bcm43455", "",d)} \
#         ${@bb.utils.contains("MACHINE_FEATURES", "wifi", "linux-firmware-bcm43456", "",d)} \
# "

IMAGE_FSTYPES += "tar.bz2 wic"
do_image_wic[depends] += "mtools-native:do_populate_sysroot dosfstools-native:do_populate_sysroot"

WKS_FILE ?= "sdimage-bootpart-meson.wks"
```

## conf/machine/include/amlogic-meson32.inc
```bitbake
# Amlogic Meson32 Configurations

require conf/machine/include/amlogic-meson.inc

KERNEL_IMAGETYPE ?= "zImage"

PREFERRED_PROVIDER_virtual/kernel ?= "linux-yocto-meson32"

SOC_FAMILY = "amlogic:meson8"
require conf/machine/include/soc-family.inc

MACHINEOVERRIDES =. "meson32all:"
```

## conf/machine/include/amlogic-meson64.inc
```bitbake
# Amlogic Meson64 Configurations

require conf/machine/include/amlogic-meson.inc

MACHINE_FEATURES_BACKFILL_CONSIDERED = "rtc"

PREFERRED_PROVIDER_virtual/kernel ?= "linux-meson64"

SOC_FAMILY = "amlogic:meson-gx"
require conf/machine/include/soc-family.inc
```

## conf/machine/include/amlogic-modern-boot.inc
```bitbake
PREFERRED_PROVIDER_virtual/kernel ?= "linux-yocto"
KERNEL_CLASSES += "kernel-fit-extra-artifacts"

KERNEL_IMAGETYPE ?= "Image"
RRECOMMENDS:${KERNEL_PACKAGE_NAME}-base = ""
MACHINE_ESSENTIAL_EXTRA_RDEPENDS += "linux-yocto-fitimage"
KERNEL_DEPLOY_DEPEND = "linux-yocto-fitimage:do_deploy"

IMAGE_BOOT_FILES = "fitImage"

PREFERRED_PROVIDER_virtual/bootloader ?= "u-boot"
PREFERRED_PROVIDER_u-boot ?= "u-boot"
PREFERRED_PROVIDER_virtual/trusted-firmware-a ?= "amlogic-boot-fip"

EXTRA_IMAGEDEPENDS += "u-boot virtual/trusted-firmware-a"

# Generate an SDCard Image
IMAGE_CLASSES += "image_types_meson"
WKS_FILE = "sdimage-meson.wks"
```

## conf/machine/include/amlogic-p200-dtb.inc
```bitbake
# Amlogic P200 dtv

KERNEL_DEVICETREE += "amlogic/meson-gxbb-p200.dtb"
IMAGE_BOOT_FILES += "meson-gxbb-p200.dtb;meson-gxbb-p200.dtb"
```

## conf/machine/include/amlogic-p201-dtb.inc
```bitbake
# Amlogic P201 dtb

KERNEL_DEVICETREE += "amlogic/meson-gxbb-p201.dtb"
IMAGE_BOOT_FILES += "meson-gxbb-p201.dtb;meson-gxbb-p201.dtb"
```

## conf/machine/include/amlogic-p212-dtb.inc
```bitbake
# Amlogic P212

KERNEL_DEVICETREE += "amlogic/meson-gxl-s905x-p212.dtb"
IMAGE_BOOT_FILES += "meson-gxl-s905x-p212.dtb;meson-gxl-s905x-p212.dtb"
```

## conf/machine/include/amlogic-p230-dtb.inc
```bitbake
# Amlogic P230

KERNEL_DEVICETREE += "amlogic/meson-gxl-s905d-p230.dtb"
IMAGE_BOOT_FILES += "meson-gxl-s905d-p230.dtb;meson-gxl-s905d-p230.dtb"
```

## conf/machine/include/amlogic-p231-dtb.inc
```bitbake
# Amlogic P231

KERNEL_DEVICETREE += "amlogic/meson-gxl-s905d-p231.dtb"
IMAGE_BOOT_FILES += "meson-gxl-s905d-p231.dtb;meson-gxl-s905d-p231.dtb"
```

## conf/machine/include/amlogic-p241-dtb.inc
```bitbake
# Amlogic P241

KERNEL_DEVICETREE += "amlogic/meson-gxl-s805x-p241.dtb"
IMAGE_BOOT_FILES += "meson-gxl-s805x-p241.dtb;meson-gxl-s805x-p241.dtb"
```

## conf/machine/include/amlogic-p281-dtb.inc
```bitbake
# Amlogic P281

KERNEL_DEVICETREE += "amlogic/meson-gxl-s905w-p281.dtb"
IMAGE_BOOT_FILES += "meson-gxl-s905w-p281.dtb;meson-gxl-s905w-p281.dtb"
```

## conf/machine/include/amlogic-q200-dtb.inc
```bitbake
# Amlogic Q200

KERNEL_DEVICETREE += "amlogic/meson-gxm-q200.dtb"
IMAGE_BOOT_FILES += "meson-gxm-q200.dtb;meson-gxm-q200.dtb"
```

## conf/machine/include/amlogic-q201-dtb.inc
```bitbake
# Amlogic Q201

KERNEL_DEVICETREE += "amlogic/meson-gxm-q201.dtb"
IMAGE_BOOT_FILES += "meson-gxm-q201.dtb;meson-gxm-q201.dtb"
```

## conf/machine/include/amlogic-s400-dtb.inc
```bitbake
# Amlogic S400 stb

KERNEL_DEVICETREE += "amlogic/meson-axg-s400.dtb"
IMAGE_BOOT_FILES += "meson-axg-s400.dtb;meson-axg-s400.dtb"
```

## conf/machine/include/amlogic-s805.inc
```bitbake
# Amlogic S805 Configurations

require conf/machine/include/amlogic-meson32.inc

MACHINE_FEATURES = "serial"

DEFAULTTUNE ?= "cortexa5hf-neon"
require conf/machine/include/tune-cortexa5.inc
```

## conf/machine/include/amlogic-s905.conf
```bitbake
# Amlogic P200

require conf/machine/amlogic-s905.inc

KERNEL_DEVICETREE = "amlogic/meson-gxbb-p200.dtb"
```

## conf/machine/include/amlogic-s905.inc
```bitbake
# Amlogic S905 Configurations

require conf/machine/include/amlogic-meson64.inc

require conf/machine/include/arm/arch-armv8a.inc

SOC_FAMILY:append = ":meson-gxbb"
```

## conf/machine/include/amlogic-s905d.inc
```bitbake
# Amlogic S905D Configurations

require conf/machine/include/amlogic-meson64.inc

require conf/machine/include/arm/arch-armv8a.inc

SOC_FAMILY:append = ":meson-gxl"
```

## conf/machine/include/amlogic-s905d2.inc
```bitbake
# Amlogic S905D2 Configurations

require conf/machine/include/amlogic-meson64.inc

require conf/machine/include/arm/arch-armv8a.inc

SOC_FAMILY:append = ":meson-g12a"
```

## conf/machine/include/amlogic-s905d3.inc
```bitbake
# Amlogic S905D3 Configurations

require conf/machine/include/amlogic-meson64.inc

require conf/machine/include/arm/arch-armv8-2a.inc

SOC_FAMILY:append = ":meson-sm1"
```

## conf/machine/include/amlogic-s905x.inc
```bitbake
# Amlogic S905X Configurations

require conf/machine/include/amlogic-meson64.inc

SOC_FAMILY:append = ":meson-gxl"
```

## conf/machine/include/amlogic-s905x2.inc
```bitbake
# Amlogic S905X2 Configurations

require conf/machine/include/amlogic-meson64.inc

SOC_FAMILY_append = ":meson-g12a"
```

## conf/machine/include/amlogic-s905x3.inc
```bitbake
# Amlogic S905X3 Configurations

require conf/machine/include/amlogic-meson64.inc

SOC_FAMILY_append = ":meson-sm1"
```
