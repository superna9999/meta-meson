## conf/machine/amlogic-u200.conf
```bitbake
#@TYPE: Machine
#@NAME: Amlogic U200 machine
#@DESCRIPTION: Machine configuration for legacy boot

require conf/machine/include/amlogic-s905d2.inc
require conf/machine/include/amlogic-u200-dtb.inc
require conf/machine/include/amlogic-legacy-boot.inc
```

## conf/machine/bananapi-bpi-cm4io.conf
```bitbake
#@TYPE: Machine
#@NAME: Banana Pi CM4IO
#@DESCRIPTION: Machine configuration

require conf/machine/include/amlogic-a311d.inc
require conf/machine/include/bananapi-bpi-cm4io-dtb.inc
require conf/machine/include/amlogic-modern-boot.inc

MACHINE_FEATURES:append = " alsa ext2 screen usbgadget usbhost sdio vfat wifi bluetooth"


UBOOT_MACHINE = "bananapi-cm4-cm4io_defconfig"
```

## conf/machine/bananapi-bpi-m2-pro.conf
```bitbake
#@TYPE: Machine
#@NAME: Banana Pi M2 Pro
#@DESCRIPTION: Machine configuration

require conf/machine/include/amlogic-s905d3.inc
require conf/machine/include/bananapi-bpi-m2-pro-dtb.inc
require conf/machine/include/amlogic-modern-boot.inc

MACHINE_FEATURES:append = " alsa ext2 screen usbgadget usbhost sdio vfat wifi bluetooth"


UBOOT_MACHINE = "bananapi-m2-pro_defconfig"
```

## conf/machine/bananapi-bpi-m2s.conf
```bitbake
#@TYPE: Machine
#@NAME: Banana Pi M2S
#@DESCRIPTION: Machine configuration

require conf/machine/include/amlogic-a311d.inc
require conf/machine/include/bananapi-bpi-m2s-dtb.inc
require conf/machine/include/amlogic-modern-boot.inc

MACHINE_FEATURES:append = " alsa ext2 screen usbgadget usbhost sdio vfat wifi bluetooth"


UBOOT_MACHINE = "bananapi-m2s_defconfig"
```

## conf/machine/bananapi-bpi-m5.conf
```bitbake
#@TYPE: Machine
#@NAME: Banana Pi M5
#@DESCRIPTION: Machine configuration

require conf/machine/include/amlogic-s905d3.inc
require conf/machine/include/bananapi-bpi-m5-dtb.inc
require conf/machine/include/amlogic-modern-boot.inc

MACHINE_FEATURES:append = " alsa ext2 screen usbgadget usbhost sdio vfat wifi bluetooth"


UBOOT_MACHINE = "bananapi-m5_defconfig"
```

## conf/machine/beelink-gt1-ultimate.conf
```bitbake
#@TYPE: Machine
#@NAME: Beelink GT1 Ultimate
#@DESCRIPTION: Machine configuration

require conf/machine/include/amlogic-s912.inc
require conf/machine/include/beelink-gt1-ultimate-dtb.inc
require conf/machine/include/amlogic-modern-boot.inc

MACHINE_FEATURES:append = " alsa ext2 screen usbgadget usbhost sdio vfat wifi bluetooth"

UBOOT_MACHINE = "beelink-gt1-ultimate_defconfig"
```

## conf/machine/cyx-a95xf3-air.conf
```bitbake
#@TYPE: Machine
#@NAME: CYX A95XF3-AIR
#@DESCRIPTION: Machine configuration for legacy boot

require conf/machine/include/amlogic-s905x3.inc
require conf/machine/include/cyx-a95xf3-air-dtb.inc
require conf/machine/include/amlogic-legacy-boot.inc

MACHINE_FEATURES:append = " alsa ext2 screen usbgadget usbhost sdio vfat wifi bluetooth"
```

## conf/machine/friendlyelec-nanopik2.conf
```bitbake
#@TYPE: Machine
#@NAME: FriendlyElec's NanoPi K2 machine
#@DESCRIPTION: Machine configuration

require conf/machine/include/amlogic-s905.inc
require conf/machine/include/friendlyelec-nanopik2-dtb.inc
require conf/machine/include/amlogic-modern-boot.inc

MACHINE_FEATURES_append = " alsa ext2 screen usbgadget usbhost sdio vfat"

PREFERRED_PROVIDER_amlogic-fip = "amlogic-fip-prebuilt"

UBOOT_MACHINE = "nanopi-k2_defconfig"
UBOOT_EXTLINUX_ROOT ?= "root=/dev/mmcblk0p1"
UBOOT_EXTLINUX_FDT = "../meson-gxbb-nanopi-k2.dtb"
```

## conf/machine/haochuangy-h96-max.conf
```bitbake
#@TYPE: Machine
#@NAME: Haochuangy H96-Max
#@DESCRIPTION: Machine configuration for legacy boot

require conf/machine/include/amlogic-s905x3.inc
require conf/machine/include/haochuangy-h96-max-dtb.inc
require conf/machine/include/amlogic-legacy-boot.inc

MACHINE_FEATURES:append = " alsa ext2 screen usbgadget usbhost sdio vfat wifi bluetooth"
```

## conf/machine/hardkernel-odroid-go-ultra.conf
```bitbake
#@TYPE: Machine
#@NAME: Hardkernel Odroid Go Ultra machine
#@DESCRIPTION: Machine configuration

require conf/machine/include/amlogic-s922x.inc
require conf/machine/include/hardkernel-odroid-go-ultra-dtb.inc
require conf/machine/include/amlogic-modern-boot.inc

MACHINE_FEATURES:append = " alsa ext2 screen usbgadget usbhost vfat"


UBOOT_MACHINE = "odroid-go-ultra_defconfig"
```

## conf/machine/hardkernel-odroid-n2l.conf
```bitbake
#@TYPE: Machine
#@NAME: Hardkernel Odroid-N2l machine
#@DESCRIPTION: Machine configuration

require conf/machine/include/amlogic-s922x.inc
require conf/machine/include/hardkernel-odroid-n2l-dtb.inc
require conf/machine/include/amlogic-modern-boot.inc

MACHINE_FEATURES:append = " alsa ext2 screen usbgadget usbhost vfat"


UBOOT_MACHINE = "odroid-n2l_defconfig"
```

## conf/machine/hardkernel-odroidc1.conf
```bitbake
#@TYPE: Machine
#@NAME: Odroid-C1 machine
#@DESCRIPTION: Machine configuration for legacy boot

require conf/machine/include/amlogic-s805.inc
require conf/machine/include/hardkernel-odroidc1-dtb.inc
require conf/machine/include/amlogic-legacy-boot.inc

# TODO: install boot.ini instead, this won't work with HardKernel's U-boot
```

## conf/machine/hardkernel-odroidc2-sdboot.conf
```bitbake
#@TYPE: Machine
#@NAME: Odroid-C2 machine
#@DESCRIPTION: Machine configuration for legacy boot

require conf/machine/include/amlogic-s905.inc
require conf/machine/include/hardkernel-odroidc2-dtb.inc
require conf/machine/include/amlogic-legacy-boot.inc

# TODO: install boot.ini instead, this won't work with HardKernel's U-boot
```

## conf/machine/hardkernel-odroidc2.conf
```bitbake
#@TYPE: Machine
#@NAME: Odroid-C2 machine
#@DESCRIPTION: Machine configuration

require conf/machine/include/amlogic-s905.inc
require conf/machine/include/hardkernel-odroidc2-dtb.inc
require conf/machine/include/amlogic-modern-boot.inc

PREFERRED_PROVIDER_amlogic-fip = "amlogic-fip-odroidc2"

UBOOT_MACHINE = "odroid-c2_config"
# Boot on SDCard
UBOOT_EXTLINUX_ROOT ?= "root=/dev/mmcblk0p1"
UBOOT_EXTLINUX_FDT = "../meson-gxbb-odroidc2.dtb"
```

## conf/machine/hardkernel-odroidc4-sdboot.conf
```bitbake
#@TYPE: Machine
#@NAME: Odroid-C4 machine
#@DESCRIPTION: Machine configuration for legacy boot

require conf/machine/include/amlogic-s905x3.inc
require conf/machine/include/hardkernel-odroidc4-dtb.inc
require conf/machine/include/amlogic-legacy-boot.inc

# TODO: install boot.ini instead, this won't work with HardKernel's U-boot

MACHINE_FEATURES_append = " alsa ext2 screen usbgadget usbhost sdio vfat"
```

## conf/machine/hardkernel-odroidc4.conf
```bitbake
# Hardkernel Odroid-C4 board

require conf/machine/include/amlogic-s905x3.inc
require conf/machine/include/hardkernel-odroidc4-dtb.inc

EXTRA_IMAGEDEPENDS += "s905-autoscript s905-autoscript-multiboot"
IMAGE_BOOT_FILES += " s905_autoscript aml_autoscript aml_autoscript.zip"
```

## conf/machine/hardkernel-odroidhc4-sdboot.conf
```bitbake
#@TYPE: Machine
#@NAME: Hardkernel Odroid-HC4 machine
#@DESCRIPTION: Machine configuration for legacy boot

require conf/machine/include/amlogic-s905x3.inc
require conf/machine/include/hardkernel-odroidhc4-dtb.inc
require conf/machine/include/amlogic-legacy-boot.inc

# TODO: install boot.ini instead, this won't work with HardKernel's U-boot

MACHINE_FEATURES:append = " alsa ext2 screen usbgadget usbhost sdio vfat"
```

## conf/machine/hardkernel-odroidhc4.conf
```bitbake
#@TYPE: Machine
#@NAME: Hardkernel Odroid-HC4 machine
#@DESCRIPTION: Machine configuration

require conf/machine/include/amlogic-s905x3.inc
require conf/machine/include/hardkernel-odroidhc4-dtb.inc
require conf/machine/include/amlogic-modern-boot.inc

MACHINE_FEATURES_append = " alsa ext2 screen usbgadget usbhost vfat"

PREFERRED_PROVIDER_amlogic-fip = "amlogic-fip-prebuilt"

UBOOT_MACHINE = "odroid-c4_defconfig"
UBOOT_EXTLINUX_ROOT ?= "root=/dev/mmcblk0p1"
UBOOT_EXTLINUX_FDT = "../meson-sm1-odroid-hc4.dtb"
```

## conf/machine/hardkernel-odroidn2-sdboot.conf
```bitbake
#@TYPE: Machine
#@NAME: Hardkernel Odroid-N2 machine
#@DESCRIPTION: Machine configuration for legacy boot

require conf/machine/include/amlogic-s922x.inc
require conf/machine/include/hardkernel-odroidn2-dtb.inc

# TODO: install boot.ini instead, this won't work with HardKernel's U-boot
EXTRA_IMAGEDEPENDS += "s905-autoscript s905-autoscript-multiboot"
IMAGE_BOOT_FILES += " s905_autoscript aml_autoscript aml_autoscript.zip"
```

## conf/machine/hardkernel-odroidn2.conf
```bitbake
#@TYPE: Machine
#@NAME: Hardkernel Odroid-N2 machine
#@DESCRIPTION: Machine configuration

require conf/machine/include/amlogic-s922x.inc
require conf/machine/include/hardkernel-odroidn2-dtb.inc
require conf/machine/include/amlogic-modern-boot.inc

MACHINE_FEATURES_append = " alsa ext2 screen usbgadget usbhost vfat"

PREFERRED_PROVIDER_amlogic-fip = "amlogic-fip-prebuilt"

UBOOT_MACHINE = "odroid-n2_defconfig"
```

## conf/machine/hardkernel-odroidn2plus-sdboot.conf
```bitbake
#@TYPE: Machine
#@NAME: Hardkernel Odroid-N2+ machine
#@DESCRIPTION: Machine configuration for legacy boot

require conf/machine/include/amlogic-s922x.inc
require conf/machine/include/hardkernel-odroidn2plus-dtb.inc
require conf/machine/include/amlogic-legacy-boot.inc

# TODO: install boot.ini instead, this won't work with HardKernel's U-boot
```

## conf/machine/hardkernel-odroidn2plus.conf
```bitbake
# Hardkernel Odroid-N2+ board

require conf/machine/include/amlogic-s922x.inc
require conf/machine/include/hardkernel-odroidn2plus-dtb.inc

KERNEL_IMAGETYPE = "Image"
IMAGE_BOOT_FILES_remove = "uImage"
IMAGE_BOOT_FILES_append = " Image"

PREFERRED_PROVIDER_amlogic-fip = "amlogic-fip-prebuilt"
PREFERRED_PROVIDER_virtual/bootloader = "u-boot-meson-gx"
PREFERRED_PROVIDER_u-boot = "u-boot-meson-gx"
PREFERRED_VERSION_u-boot-meson-gx = "2021.07%"

UBOOT_MACHINE = "odroid-n2_defconfig"
UBOOT_EXTLINUX = "1"
UBOOT_EXTLINUX_ROOT ?= "root=/dev/mmcblk0p1"
UBOOT_EXTLINUX_FDT = "../meson-g12b-odroid-n2-plus.dtb"
UBOOT_EXTLINUX_CONSOLE = "console=ttyAML0"

MACHINE_ESSENTIAL_EXTRA_RDEPENDS += " \
       kernel-image \
       kernel-devicetree \
       u-boot-meson-gx \
"

# Generate an SDCard Image
IMAGE_CLASSES += "image_types_meson"

WKS_FILE = "sdimage-meson.wks"
```

## conf/machine/hwacom-amazetv.conf
```bitbake
#@TYPE: Machine
#@NAME: Hwacom Amazetv machine
#@DESCRIPTION: Machine configuration for legacy boot

require conf/machine/include/amlogic-s905x.inc
require conf/machine/include/hwacom-amazetv-dtb.inc
require conf/machine/include/amlogic-legacy-boot.inc
```

## conf/machine/include/amediatech-x96-max-dtb.inc
```bitbake
# Amediatech X96 Max

KERNEL_DEVICETREE += "amlogic/meson-g12a-x96-max.dtb"
IMAGE_BOOT_FILES += "meson-g12a-x96-max.dtb:meson-g12a-x96-max.dtb"
```

## conf/machine/include/amlogic-a113d.inc
```bitbake
# Amlogic A113D Configurations

require conf/machine/include/amlogic-meson64.inc

SOC_FAMILY_append = ":meson-axg"
```
