## conf/layer.conf
```bitbake
# We have a conf and classes directory, add to BBPATH
BBPATH .= ":${LAYERDIR}"

# We have recipes-* directories, add to BBFILES
BBFILES += "${LAYERDIR}/recipes-*/*/*.bb ${LAYERDIR}/recipes-*/*/*.bbappend"

BBFILE_COLLECTIONS += "meson"
BBFILE_PATTERN_meson = "^${LAYERDIR}/"
BBFILE_PRIORITY_meson = "1"
LAYERSERIES_COMPAT_meson = "rocko sumo"

# This should only be incremented on significant changes that will
# cause compatibility issues with other layers
LAYERVERSION_meson = "1"

LAYERDEPENDS_meson = "core"
```

## conf/machine/amediatech-x96-max.conf
```bitbake
#@TYPE: Machine
#@NAME: Amediatech X96 Max machine
#@DESCRIPTION: Machine configuration for legacy boot

require conf/machine/include/amlogic-s905x2.inc
require conf/machine/include/amediatech-x96-max-dtb.inc

EXTRA_IMAGEDEPENDS += "s905-autoscript s905-autoscript-multiboot"
IMAGE_BOOT_FILES += " s905_autoscript aml_autoscript aml_autoscript.zip"
```

## conf/machine/amlogic-fit.conf
```bitbake
#
# Build an upstream yocto kernel (linux-yocto-dev) as a FIT image
# including DTBs for all supported boards and ramdisk.
#
# Can be booted on any board running mainline u-boot with FIT support
# u-boot will have an $fdtfile env variable which can be used to select
# the right DT config from the FIT image.
#
# To boot this FIT image in u-boot (see u-boot requirements below)
#
# - load FIT image into memory at $loadaddr
#
# - tweak the $fdtfile (replace '/' with '_')
#   => setexpr fdtfile gsub '/' '_'
#
# - boot FIT image using modified $fdtfile to select the right FIT config
#   =>  bootm ${loadaddr}#conf@${fdtfile}
#
# u-boot requirements:
#
# FIT support:
#   CONFIG_FIT=y
#   CONFIG_FIT_SIGNATURE=y
#   CONFIG_FIT_VERBOSE=y
#
# setexpr support
#   CONFIG_CMD_SETEXPR=y
#
#   This is needed because $fdtfile in u-boot env has a `/` which is
#   converted into a '_' when FIT image configs are created.
#

# include all currently supported S9xxx machine.
require conf/machine/amlogic-s9xxx.conf

#
# Kernel
# - Use standard linux-yocto-dev recipe, drop custom uImage, build FIT image
#
PREFERRED_PROVIDER_virtual/kernel_meson-gx ?= "linux-yocto-dev"
KMACHINE_meson-gx = "meson-gx"
KERNEL_CLASSES_meson-gx = "kernel kernel-fitimage"
KERNEL_IMAGETYPE_meson-gx = "Image"
KERNEL_IMAGETYPES_append_meson-gx = " fitImage"
# undo misc. meta-meson defaults
IMAGE_BOOT_FILES_remove_meson-gx = "uImage"

MACHINE_ESSENTIAL_EXTRA_RDEPENDS += " \
       kernel-image \
       kernel-devicetree \
"

# include initrd into FIT image
INITRAMFS_IMAGE = "amlogic-image-headless-initrd"
```

## conf/machine/amlogic-meson32.inc
```bitbake
# Amlogic Meson32 Configurations

require conf/machine/amlogic-meson.inc

KERNEL_IMAGETYPE ?= "zImage"

PREFERRED_PROVIDER_virtual/kernel ?= "linux-yocto-meson32"

SOC_FAMILY = "amlogic:meson8"
require conf/machine/include/soc-family.inc
```

## conf/machine/amlogic-p200-sdboot.conf
```bitbake
#@TYPE: Machine
#@NAME: Amlogic P200 machine
#@DESCRIPTION: Machine configuration for legacy boot

require conf/machine/include/amlogic-s905.inc
require conf/machine/include/amlogic-p200-dtb.inc
require conf/machine/include/amlogic-legacy-boot.inc
```

## conf/machine/amlogic-p200.conf
```bitbake
#@TYPE: Machine
#@NAME: Amlogic P200 machine
#@DESCRIPTION: Machine configuration

require conf/machine/include/amlogic-s905.inc
require conf/machine/include/amlogic-p200-dtb.inc
require conf/machine/include/amlogic-modern-boot.inc

MACHINE_FEATURES_append = " alsa ext2 screen usbgadget usbhost sdio vfat wifi bluetooth"

PREFERRED_PROVIDER_amlogic-fip = "amlogic-fip-prebuilt"

UBOOT_MACHINE = "p200_defconfig"
```

## conf/machine/amlogic-p201-sdboot.conf
```bitbake
#@TYPE: Machine
#@NAME: Amlogic P201 machine
#@DESCRIPTION: Machine configuration for legacy boot

require conf/machine/include/amlogic-s905.inc
require conf/machine/include/amlogic-p201-dtb.inc
require conf/machine/include/amlogic-legacy-boot.inc
```

## conf/machine/amlogic-p201.conf
```bitbake
#@TYPE: Machine
#@NAME: Amlogic P201 machine
#@DESCRIPTION: Machine configuration

require conf/machine/include/amlogic-s905.inc
require conf/machine/include/amlogic-p201-dtb.inc
require conf/machine/include/amlogic-legacy-boot.inc

MACHINE_FEATURES_append = " alsa ext2 screen usbgadget usbhost sdio vfat wifi bluetooth"


UBOOT_MACHINE = "p201_defconfig"
```

## conf/machine/amlogic-p212-sdboot.conf
```bitbake
#@TYPE: Machine
#@NAME: Amlogic P212 machine
#@DESCRIPTION: Machine configuration for legacy boot

require conf/machine/include/amlogic-s905x.inc
require conf/machine/include/amlogic-p212-dtb.inc
require conf/machine/include/amlogic-legacy-boot.inc
```

## conf/machine/amlogic-p212.conf
```bitbake
#@TYPE: Machine
#@NAME: Amlogic P212 machine
#@DESCRIPTION: Machine configuration

require conf/machine/include/amlogic-s905x.inc
require conf/machine/include/amlogic-p212-dtb.inc
require conf/machine/include/amlogic-modern-boot.inc

MACHINE_FEATURES_append = " alsa ext2 screen usbgadget usbhost sdio vfat wifi bluetooth"


UBOOT_MACHINE = "p212_defconfig"
```

## conf/machine/amlogic-p230.conf
```bitbake
#@TYPE: Machine
#@NAME: Amlogic P230 machine
#@DESCRIPTION: Machine configuration for legacy boot

require conf/machine/include/amlogic-s905d.inc
require conf/machine/include/amlogic-p230-dtb.inc
require conf/machine/include/amlogic-legacy-boot.inc

MACHINE_FEATURES_append = " alsa ext2 screen usbgadget usbhost sdio vfat wifi bluetooth"
```

## conf/machine/amlogic-p231.conf
```bitbake
#@TYPE: Machine
#@NAME: Amlogic P231 machine
#@DESCRIPTION: Machine configuration for legacy boot

require conf/machine/include/amlogic-s905d.inc
require conf/machine/include/amlogic-p231-dtb.inc
require conf/machine/include/amlogic-legacy-boot.inc

MACHINE_FEATURES_append = " alsa ext2 screen usbgadget usbhost sdio vfat wifi bluetooth"
```

## conf/machine/amlogic-p241.conf
```bitbake
#@TYPE: Machine
#@NAME: Amlogic P241 machine
#@DESCRIPTION: Machine configuration for legacy boot

require conf/machine/include/amlogic-s905x.inc
require conf/machine/include/amlogic-p241-dtb.inc
require conf/machine/include/amlogic-legacy-boot.inc

MACHINE_FEATURES_append = " alsa ext2 screen usbgadget usbhost sdio vfat wifi bluetooth"
```

## conf/machine/amlogic-p281.conf
```bitbake
#@TYPE: Machine
#@NAME: P281 machine
#@DESCRIPTION: Machine configuration for legacy boot

require conf/machine/include/amlogic-s905x.inc
require conf/machine/include/amlogic-p281-dtb.inc
require conf/machine/include/amlogic-legacy-boot.inc
```

## conf/machine/amlogic-q200.conf
```bitbake
#@TYPE: Machine
#@NAME: Amlogic Q200 machine
#@DESCRIPTION: Machine configuration for legacy boot

require conf/machine/include/amlogic-s912.inc
require conf/machine/include/amlogic-q200-dtb.inc
require conf/machine/include/amlogic-legacy-boot.inc
```

## conf/machine/amlogic-q201.conf
```bitbake
#@TYPE: Machine
#@NAME: Amlogic Q201 machine
#@DESCRIPTION: Machine configuration for legacy boot

require conf/machine/include/amlogic-s912.inc
require conf/machine/include/amlogic-q201-dtb.inc
require conf/machine/include/amlogic-legacy-boot.inc
```

## conf/machine/amlogic-s400.conf
```bitbake
#@TYPE: Machine
#@NAME: Amlogic S400 machine
#@DESCRIPTION: Machine configuration for eMMC boot

require conf/machine/include/amlogic-a113d.inc
require conf/machine/include/amlogic-s400-dtb.inc
require conf/machine/include/amlogic-modern-boot.inc

MACHINE_FEATURES_append = " alsa ext2 usbgadget usbhost sdio vfat wifi bluetooth"

PREFERRED_PROVIDER_amlogic-fip = "amlogic-fip-prebuilt"

UBOOT_MACHINE = "s400_defconfig"

MACHINE_ESSENTIAL_EXTRA_RDEPENDS += " \
       alsa-board-conf \
       alsa-state \
"
```

## conf/machine/amlogic-s805.conf
```bitbake
#@TYPE: Machine
#@NAME: Amlogic S805 machine
#@DESCRIPTION: Machine configuration for generic S805 non-bootable image

require conf/machine/include/amlogic-s805.inc
require conf/machine/include/hardkernel-odroidc1-dtb.inc
```

## conf/machine/amlogic-s805.inc
```bitbake
# Amlogic S805 Configurations

require conf/machine/amlogic-meson32.inc

MACHINE_FEATURES = "serial"

DEFAULTTUNE ?= "cortexa5hf"
require conf/machine/include/tune-cortexa5.inc
```

## conf/machine/amlogic-s905.conf
```bitbake
# Amlogic S905 boards

require conf/machine/include/amlogic-s905.inc
require conf/machine/include/amlogic-p200-dtb.inc
require conf/machine/include/amlogic-p201-dtb.inc
require conf/machine/include/hardkernel-odroidc2-dtb.inc
require conf/machine/include/tronsmart-vega-s95-meta-dtb.inc
require conf/machine/include/tronsmart-vega-s95-pro-dtb.inc
require conf/machine/include/tronsmart-vega-s95-telos-dtb.inc
require conf/machine/include/nexbox-a95x-s905-dtb.inc
require conf/machine/include/wetek-hub-dtb.inc
require conf/machine/include/wetek-play2-dtb.inc
require conf/machine/include/friendlyelec-nanopik2-dtb.inc
```

## conf/machine/amlogic-s905.inc
```bitbake
# Amlogic S905 Configurations

require conf/machine/amlogic-meson64.inc

MACHINE_FEATURES = "serial usbhost sdio"
```

## conf/machine/amlogic-s905d.conf
```bitbake
#@TYPE: Machine
#@NAME: S905d machine
#@DESCRIPTION: Machine configuration for S905D non-bootable image

require conf/machine/include/amlogic-s905d.inc
require conf/machine/include/amlogic-p230-dtb.inc
require conf/machine/include/amlogic-p231-dtb.inc
require conf/machine/include/mecool-kii-pro-dtb.inc
require conf/machine/include/osmc-vero4k-plus-dtb.inc

KERNEL_IMAGETYPE ?= "Image"
```

## conf/machine/amlogic-s905x.conf
```bitbake
#@TYPE: Machine
#@NAME: S905x machine
#@DESCRIPTION: Machine configuration for S905X non-bootable image

require conf/machine/include/amlogic-s905x.inc
require conf/machine/include/amlogic-p212-dtb.inc
require conf/machine/include/nexbox-a95x-s905x-dtb.inc
require conf/machine/include/khadas-vim-dtb.inc
require conf/machine/include/hwacom-amazetv-dtb.inc
require conf/machine/include/libretech-cc-dtb.inc
require conf/machine/include/oranth-tx3-mini-dtb.inc

KERNEL_IMAGETYPE ?= "Image"
```

## conf/machine/amlogic-s912.conf
```bitbake
#@TYPE: Machine
#@NAME: S912 machine
#@DESCRIPTION: Machine configuration for S912 non-bootable image

require conf/machine/include/amlogic-s912.inc
require conf/machine/include/amlogic-q200-dtb.inc
require conf/machine/include/amlogic-q201-dtb.inc
require conf/machine/include/beelink-gt1-ultimate-dtb.inc
require conf/machine/include/khadas-vim2-dtb.inc
require conf/machine/include/kingnovel-rbox-pro-dtb.inc
require conf/machine/include/mecool-kiii-pro-dtb.inc
require conf/machine/include/minix-neo-u9h-dtb.inc
require conf/machine/include/nexbox-a1-dtb.inc
require conf/machine/include/tronsmart-vega-s96-dtb.inc

KERNEL_IMAGETYPE ?= "Image"
```

## conf/machine/amlogic-s9xxx.conf
```bitbake
#@TYPE: Machine
#@NAME: S905/S905X/S905D/S805X/S912/AXG machine
#@DESCRIPTION: Machine configuration for S905/S905X/S905D/S805X/S912/AXG non-bootable image

require conf/machine/include/amlogic-s9xxx.inc
require conf/machine/include/amlogic-p212-dtb.inc
require conf/machine/include/nexbox-a95x-s905x-dtb.inc
require conf/machine/include/khadas-vim-dtb.inc
require conf/machine/include/khadas-vim2-dtb.inc
require conf/machine/include/hwacom-amazetv-dtb.inc
require conf/machine/include/amlogic-p200-dtb.inc
require conf/machine/include/amlogic-p201-dtb.inc
require conf/machine/include/hardkernel-odroidc2-dtb.inc
require conf/machine/include/tronsmart-vega-s95-meta-dtb.inc
require conf/machine/include/tronsmart-vega-s95-pro-dtb.inc
require conf/machine/include/tronsmart-vega-s95-telos-dtb.inc
require conf/machine/include/nexbox-a95x-s905-dtb.inc
require conf/machine/include/wetek-hub-dtb.inc
require conf/machine/include/wetek-play2-dtb.inc
require conf/machine/include/amlogic-p230-dtb.inc
require conf/machine/include/amlogic-p231-dtb.inc
require conf/machine/include/amlogic-q200-dtb.inc
require conf/machine/include/amlogic-q201-dtb.inc
require conf/machine/include/nexbox-a1-dtb.inc
require conf/machine/include/libretech-ac-dtb.inc
require conf/machine/include/libretech-cc-dtb.inc
require conf/machine/include/kingnovel-rbox-pro-dtb.inc
require conf/machine/include/tronsmart-vega-s96-dtb.inc
require conf/machine/include/amlogic-p241-dtb.inc
require conf/machine/include/amlogic-p281-dtb.inc
require conf/machine/include/amlogic-s400-dtb.inc
require conf/machine/include/friendlyelec-nanopik2-dtb.inc
require conf/machine/include/oranth-tx3-mini-dtb.inc
require conf/machine/include/amlogic-u200-dtb.inc
require conf/machine/include/hardkernel-odroidn2-dtb.inc
require conf/machine/include/khadas-vim3-dtb.inc
require conf/machine/include/khadas-vim3l-dtb.inc
require conf/machine/include/seirobotics-sei510-dtb.inc
require conf/machine/include/seirobotics-sei610-dtb.inc
require conf/machine/include/hardkernel-odroidn2plus-dtb.inc
require conf/machine/include/hardkernel-odroidc4-dtb.inc
require conf/machine/include/hardkernel-odroidhc4-dtb.inc

KERNEL_IMAGETYPE = "uImage"
KERNEL_CLASSES = "kernel-uimage-meson"
```
